## 03-pwm-led/west.yml
```yaml
# Copyright (c) 2021 Chien
# SPDX-License-Identifier: MIT


manifest:
  self:
    path: zephyr-practice/01-led

  remotes:
    - name: zephyrproject-rtos
      url-base: https://github.com/zephyrproject-rtos

  projects:
    - name: zephyr
      remote: zephyrproject-rots
      revision: main
      import: true
```

## 08-net_shell/west.yml
```yaml
# Copyright (c) 2022 Chien
# SPDX-License-Identifier: MIT

manifest:
  self:
    path: zephyr-practice/08-net_shell

  remotes:
    - name: zephyrproject-rtos
      url-base: https://github.com/zephyrproject-rtos

  projects:
    - name: zephyr
      remote: zephyrproject-rtos
      revision: v3.2.0
      import: true
```

## 11-USB_CDC_ACM/west.yml
```yaml
# Copyright (c) 2022 Chien Hung Lin
# # SPDX-License-Identifier: Apache-2.0

manifest:
  self:
    path: zephyr-practice/11-USB_CDC_ACM


  remotes:
    - name: zephyrproject-rtos
      url-base: https://github.com/zephyrproject-rtos


  projects:
    - name: 11-USB_CDC_ACM
      remote: zephyrproject-rtos
      reviision: main
      import: true
```

## 12-tracing_usb_backend/west.yml
```yaml
# Copyright (c) 2022 Chien
# SPDX-License-Identifier: MIT


manifest:
  self:
    path: zephyr-practice/12-tracing_usb_backend

  remotes:
    - name: zephyrproject-rtos
      url-base: https://github.com/zephyrproject-rtos

  projects:
    - name: zephyr
      remote: zephyrproject-rots
      revision: v3.2.0
      import: true
```
