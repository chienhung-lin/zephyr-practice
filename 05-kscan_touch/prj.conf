## CMakeLists.txt
```
# SPDX-License-Identifier: Apache-2.0

cmake_minimum_required(VERSION 3.20.0)

set(BOARD disco_l475_iot1)
set(SHIELD adafruit_2_8_tft_touch_v2)

find_package(Zephyr REQUIRED HINTS $ENV{ZEPHYR_BASE})
project(05-kscan_touch)

FILE(GLOB app_sources src/*.c)
target_sources(app PRIVATE ${app_sources})
```

## west.yml
```
# Copyright (c) 2021 Chien
# SPDX-License-Identifier: MIT


manifest:
  self:
    path: zephyr-practice/05-kscan_touch

  remotes:
    - name: zephyrproject-rtos
      url-base: https://github.com/zephyrproject-rtos

  projects:
    - name: zephyr
      remote: zephyrproject-rots
      revision: v3.2.0
      import: true
```

## prj.conf
```kconfig
CONFIG_STDOUT_CONSOLE=y
CONFIG_PRINTK=y

CONFIG_LOG=y

CONFIG_KSCAN=y
CONFIG_I2C=y
CONFIG_KSCAN_FT5336=y
CONFIG_KSCAN_FT5336_INTERRUPT=y
```

## boards/disco_l475_iot1.overlay
```dts
/ {
	chosen {
		zephyr,keyboard-scan = &touch_controller;
	};
};

&touch_controller {
	int-gpios = <&arduino_header 13 GPIO_ACTIVE_LOW>;
};
```

## src/main.c
```c
/*
 * Copyright (c) 2020 Mark Olsson <mark@markolsson.se>
 *
 * SPDX-License-Identifier: Apache-2.0
 */

#include <zephyr/kernel.h>
#include <zephyr/drivers/kscan.h>

#define LOG_LEVEL LOG_LEVEL_DBG
#include <zephyr/logging/log.h>

LOG_MODULE_REGISTER(main);

struct touch_item_type {
	int row;
	int col;
};

#define TOUCH_MSGQ_SIZE 10
#define TOUCH_MSGQ_ALIGN 4

K_MSGQ_DEFINE(touch_msgq, sizeof(struct touch_item_type),
						  TOUCH_MSGQ_SIZE, TOUCH_MSGQ_ALIGN);

const struct device *kscan_dev = DEVICE_DT_GET(DT_CHOSEN(zephyr_keyboard_scan));

static void k_callback(const struct device *dev, uint32_t row, uint32_t col,
		       bool pressed)
{
	struct touch_item_type touch_item;
	int ret;

	ARG_UNUSED(dev);

	if (pressed) {
		printk("kscan callback row = %u col = %u\n", row, col);
		touch_item.row = row;
		touch_item.col = col;
		ret = k_msgq_put(&touch_msgq, &touch_item, K_NO_WAIT);
		if (ret != 0) {
			printk("k_msgq_put failed - %d\n", ret);
		}
	}
}

static void touch_entry(void *p1, void *p2, void *p3)
{
	struct touch_item_type touch_item;
	int ret;

	if (!device_is_ready(kscan_dev)) {
		LOG_ERR("kscan device %s not ready", kscan_dev->name);
		return;
	}

	kscan_config(kscan_dev, k_callback);
	kscan_enable_callback(kscan_dev);

	while (1) {
		if ((ret = k_msgq_get(&touch_msgq, &touch_item, K_FOREVER)) == 0) {
			LOG_INF("get touch_item: row = %u, col = %u",
					     touch_item.row, touch_item.col);
		} else {
			LOG_ERR("k_msgq_get failed - %d", ret);
		}
	}
}

#define TOUCH_TASK_STACK_SIZE 1024
#define TOUCH_TASK_PRIORITY 8

K_THREAD_DEFINE(touch_tid, TOUCH_TASK_STACK_SIZE,
							touch_entry, NULL, NULL, NULL,
							TOUCH_TASK_PRIORITY, 0, 0);

void main(void)
{
	printk("empty main function\n");
}
```
